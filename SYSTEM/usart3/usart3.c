//chassis J10 usart3

#include "sys.h"
#include "usart3.h"
#include <stdlib.h>

u8 MotorSpeed_Re_Date[16];
u8 MotorSpeed_Re_Count;
u8 MotorSpeed_Re_Flag;
ReturnedWheel ReturnedWheelData[9] = {0};

u8  MotorSpeed_Se_Date[70] = {0x00, 0x00, 0x00, 0x00, 0x00, 0x00, 0x00, 0x00, 0x00, 0x00, 0x00, 0x00, 0x00, 0x00, 0x00, 0x00, 0x00, 0x00, 0x00, 0x00, 0x00, 0x00, 0x00, 0x00, 0x00, 0x00, 0x00, 0x00,
                              0x00, 0x00, 0x00, 0x00, 0x00, 0x00, 0x00, 0x00, 0x00, 0x00, 0x00, 0x00, 0x00, 0x00, 0x00, 0x00, 0x00, 0x00, 0x00, 0x00, 0x00, 0x00, 0x00, 0x00, 0x00, 0x00, 0x00, 0x00,
                              0x00, 0x00, 0x00, 0x00, 0x00, 0x00, 0x00, 0x00, 0x00, 0x00, 0x00, 0x00, 0x00, 0x00
                             };//主机发送该指令，控制8路电机速度等状态

s16 motor1_speed = 0; //1号电机速度
s16 motor2_speed = 0; //2号电机速度
s16 motor3_speed = 0; //3号电机速度
s16 motor4_speed = 0; //4号电机速度
s16 motor5_speed = 0; //5号电机速度
s16 motor6_speed = 0; //6号电机速度
s16 motor7_speed = 0; //7号电机速度
s16 motor8_speed = 0; //8号电机速度

s16 motor1_addspeed = 5000; //1号电机加速度
s16 motor2_addspeed = 5000; //2号电机加速度
s16 motor3_addspeed = 3000; //3号电机加速度
s16 motor4_addspeed = 1000; //4号电机加速度
s16 motor5_addspeed = 1000; //5号电机加速度
s16 motor6_addspeed = 1000; //6号电机加速度
s16 motor7_addspeed = 1000; //7号电机加速度
s16 motor8_addspeed = 1000; //8号电机加速度


/*****16位CRC检验表，低位在前，高位在后*******/

//////////////*高位表*///////////////////
const u8 auchCRCHi[] =
{
    0x00, 0xC1, 0x81, 0x40, 0x01, 0xC0, 0x80, 0x41, 0x01, 0xC0, 0x80, 0x41, 0x00, 0xC1, 0x81, //
    0x40, 0x01, 0xC0, 0x80, 0x41, 0x00, 0xC1, 0x81, 0x40, 0x00, 0xC1, 0x81, 0x40, 0x01, 0xC0,
    0x80, 0x41, 0x01, 0xC0, 0x80, 0x41, 0x00, 0xC1, 0x81, 0x40, 0x00, 0xC1, 0x81, 0x40, 0x01,
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    0x00, 0xC1, 0x81, 0x40, 0x01, 0xC0, 0x80, 0x41, 0x01, 0xC0, 0x80, 0x41, 0x00, 0xC1, 0x81,
    0x40
};

//////////////*低位表*///////////////////
const u8 auchCRCLo[] =
{
    0x00, 0xC0, 0xC1, 0x01, 0xC3, 0x03, 0x02, 0xC2, 0xC6, 0x06, 0x07, 0xC7, 0x05, 0xC5, 0xC4,
    0x04, 0xCC, 0x0C, 0x0D, 0xCD, 0x0F, 0xCF, 0xCE, 0x0E, 0x0A, 0xCA, 0xCB, 0x0B, 0xC9, 0x09,
    0x08, 0xC8, 0xD8, 0x18, 0x19, 0xD9, 0x1B, 0xDB, 0xDA, 0x1A, 0x1E, 0xDE, 0xDF, 0x1F, 0xDD,
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    0x44, 0x84, 0x85, 0x45, 0x87, 0x47, 0x46, 0x86, 0x82, 0x42, 0x43, 0x83, 0x41, 0x81, 0x80,
    0x40
};
////////*16位CRC校验函数查表法*////////////////
u16 crc16(u8* puchMsg, u8 usDataLen)
{
    u8 uchCRCHi = 0xFF ;
    u8 uchCRCLo = 0xFF ;
    u16 uIndex ;
    while(usDataLen--)
    {
        uIndex = uchCRCHi ^ * puchMsg++ ;
        uchCRCHi = uchCRCLo^ auchCRCHi[uIndex] ;
        uchCRCLo = auchCRCLo[uIndex] ;
    }
    return (((u8)(uchCRCLo) << 8) | uchCRCHi) ;
}
/**********************************************
串口配置函数
RS485通信控制电机
配置了串口3，PD8 PD9
115200,8b，1，N
接收中断使能
无发送
**********************************************/
void USART3_Init(u32 bound)
{
    GPIO_InitTypeDef gpio_initstructure;
    USART_InitTypeDef usart_initstructure;
    //USART_ClockInitTypeDef usart_clockinitstructure;
    NVIC_InitTypeDef NVIC_InitStructure;

    RCC_AHB1PeriphClockCmd(RCC_AHB1Periph_GPIOD, ENABLE); //使能GPIOD时钟
    RCC_APB1PeriphClockCmd(RCC_APB1Periph_USART3, ENABLE); //使能USART3时钟
    USART_DeInit(USART3);  //复位串口3

    GPIO_PinAFConfig(GPIOD, GPIO_PinSource8, GPIO_AF_USART3);
    GPIO_PinAFConfig(GPIOD, GPIO_PinSource9, GPIO_AF_USART3);
    /* D5 USART3_Tx */
    gpio_initstructure.GPIO_Pin = GPIO_Pin_8;
    gpio_initstructure.GPIO_Mode = GPIO_Mode_AF;
    gpio_initstructure.GPIO_OType = GPIO_OType_PP;
    gpio_initstructure.GPIO_Speed = GPIO_Speed_50MHz;
    gpio_initstructure.GPIO_PuPd = GPIO_PuPd_UP;
    GPIO_Init(GPIOD, & gpio_initstructure);

    /* D6 USART3_Rx  */
    gpio_initstructure.GPIO_Pin = GPIO_Pin_9;
    gpio_initstructure.GPIO_Mode = GPIO_Mode_AF;
    //gpio_initstructure.GPIO_OType = GPIO_OType_PP;
    gpio_initstructure.GPIO_Speed = GPIO_Speed_50MHz;
    gpio_initstructure.GPIO_PuPd = GPIO_PuPd_NOPULL;
    GPIO_Init(GPIOD, & gpio_initstructure);

    usart_initstructure.USART_BaudRate = bound;
    usart_initstructure.USART_WordLength = USART_WordLength_8b;
    usart_initstructure.USART_StopBits = USART_StopBits_1;
    usart_initstructure.USART_Parity = USART_Parity_No;
    usart_initstructure.USART_HardwareFlowControl = USART_HardwareFlowControl_None;
    usart_initstructure.USART_Mode = USART_Mode_Rx | USART_Mode_Tx;
    USART_Init(USART3, & usart_initstructure);
    USART_Cmd(USART3, ENABLE);
    USART_ITConfig(USART3, USART_IT_RXNE, ENABLE);

    NVIC_InitStructure.NVIC_IRQChannel = USART3_IRQn;//串口5中断通道
    NVIC_InitStructure.NVIC_IRQChannelPreemptionPriority = 2; //抢占优先级3
    NVIC_InitStructure.NVIC_IRQChannelSubPriority = 3;      //子优先级3
    NVIC_InitStructure.NVIC_IRQChannelCmd = ENABLE;         //IRQ通道使能
    NVIC_Init( & NVIC_InitStructure); //根据指定的参数初始化VIC寄存器、
}

void USART3_SendOneByte(u8 dat)
{
    while((USART3->SR & 0X40) == 0) {};  //循环发送,直到发送完毕
    USART3->DR = (u8) dat;
    while(USART_GetFlagStatus(USART3, USART_FLAG_TC) == RESET);
}

void USART3_SendStr(u8* pucStr, u8 ulNum)
{
    u8 i;
    for(i = 0; i < ulNum; i++)
    {
        USART3_SendOneByte( * pucStr++);
    }
}
/*
1、4号轮使用地址1的驱动器，M1 接1号轮 M2接4号轮
2、5号轮使用地址2的驱动器，M1 接2号轮 M2接5号轮
3、6号轮使用地址3的驱动器，M1 接3号轮 M2接6号轮
*/

void Sent_MotorSpeed_code(void)
{
    u8 i;
    MotorSpeed_Se_Date[0] = 0x55;
    MotorSpeed_Se_Date[1] = 0x00;
    MotorSpeed_Se_Date[2] = 0x46;
    MotorSpeed_Se_Date[3] = 0x00;

    /*1号轮速度1*/
    MotorSpeed_Se_Date[4] = motor1_speed >> 8;
    MotorSpeed_Se_Date[5] = motor1_speed & 0x00ff;
    /*1号轮加速度*/
    MotorSpeed_Se_Date[6] = motor1_addspeed >> 8;
    MotorSpeed_Se_Date[7] = motor1_addspeed & 0x00ff;

    /*2号轮*/
    MotorSpeed_Se_Date[12] = motor2_speed >> 8;
    MotorSpeed_Se_Date[13] = motor2_speed & 0x00ff;
    /*2号轮加速度*/
    MotorSpeed_Se_Date[14] = motor2_addspeed >> 8;
    MotorSpeed_Se_Date[15] = motor2_addspeed & 0x00ff;

    /*3号轮*/
    MotorSpeed_Se_Date[20] = motor3_speed >> 8;
    MotorSpeed_Se_Date[21] = motor3_speed & 0x00ff;
    /*3号轮加速度*/
    MotorSpeed_Se_Date[22] = motor3_addspeed >> 8;
    MotorSpeed_Se_Date[23] = motor3_addspeed & 0x00ff;

    /*4号轮*/
    MotorSpeed_Se_Date[28] = motor4_speed >> 8;
    MotorSpeed_Se_Date[29] = motor4_speed & 0x00ff;
    /*4号轮加速度*/
    MotorSpeed_Se_Date[30] = motor4_addspeed >> 8;
    MotorSpeed_Se_Date[31] = motor4_addspeed & 0x00ff;

    /*5号轮*/
    MotorSpeed_Se_Date[36] = motor5_speed >> 8;
    MotorSpeed_Se_Date[37] = motor5_speed & 0x00ff;
    /*5号轮加速度*/
    MotorSpeed_Se_Date[38] = motor5_addspeed >> 8;
    MotorSpeed_Se_Date[39] = motor5_addspeed & 0x00ff;

    /*6号轮*/
    MotorSpeed_Se_Date[44] = motor6_speed >> 8;
    MotorSpeed_Se_Date[45] = motor6_speed & 0x00ff;
    /*6号轮加速度*/
    MotorSpeed_Se_Date[46] = motor6_addspeed >> 8;
    MotorSpeed_Se_Date[47] = motor6_addspeed & 0x00ff;

    /*7号轮*/
    MotorSpeed_Se_Date[52] = motor7_speed >> 8;
    MotorSpeed_Se_Date[53] = motor7_speed & 0x00ff;
    /*7号轮加速度*/
    MotorSpeed_Se_Date[54] = motor7_addspeed >> 8;
    MotorSpeed_Se_Date[55] = motor7_addspeed & 0x00ff;

    /*8号轮*/
    MotorSpeed_Se_Date[60] = motor8_speed >> 8;
    MotorSpeed_Se_Date[61] = motor8_speed & 0x00ff;
    /*8号轮加速度*/
    MotorSpeed_Se_Date[62] = motor8_addspeed >> 8;
    MotorSpeed_Se_Date[63] = motor8_addspeed & 0x00ff;

    MotorSpeed_Se_Date[68] = crc16(MotorSpeed_Se_Date, 68) & 0x00ff;
    MotorSpeed_Se_Date[69] = crc16(MotorSpeed_Se_Date, 68) >> 8;;

    for(i = 0; i < 70; i++)
    {
        USART3_SendOneByte(MotorSpeed_Se_Date[i]);
    }
}

void USART3_IRQHandler(void)                    //串口3中断服务程序
{
    if(USART_GetITStatus(USART3, USART_IT_RXNE) != RESET)           // 空闲中断
    {
        MotorSpeed_Re_Date[MotorSpeed_Re_Count] = USART_ReceiveData(USART3);
        MotorSpeed_Re_Count++;
        if(MotorSpeed_Re_Date[0] == 0xAA)
        {
            if(MotorSpeed_Re_Count > 9)
            {
                int receivedCRC = (MotorSpeed_Re_Date[9] << 8) | MotorSpeed_Re_Date[8];
                int expectedCRC = crc16(MotorSpeed_Re_Date, 8);
                if(expectedCRC == receivedCRC) {
                    MotorSpeed_Re_Count = 0;
                    MotorSpeed_Re_Flag = 1;
                } else {
                    MotorSpeed_Re_Count = 0;
                    MotorSpeed_Re_Flag = 0;
                }
            }
        }
        else
        {
            MotorSpeed_Re_Count = 0;
        }
        USART_ClearITPendingBit(USART3, USART_IT_RXNE);
    }
    if(USART_GetITStatus(USART3, USART_IT_TXE) == SET)
    {
        USART_ClearITPendingBit(USART3, USART_IT_TXE);
    }
}

int8_t ReturnReviseFlag;
void WheelReturnedDataHandle(void)
{
    if(MotorSpeed_Re_Flag == 1)
    {
        ReturnedWheelData[MotorSpeed_Re_Date[1]].ReturnedWheelSpeedValue = (MotorSpeed_Re_Date[6] << 8) | MotorSpeed_Re_Date[7];
        ReturnedWheelData[MotorSpeed_Re_Date[1]].ReturnedWheelErrorCode = MotorSpeed_Re_Date[5];

        if(MotorSpeed_Re_Date[1] == 1 || MotorSpeed_Re_Date[1] == 2 || MotorSpeed_Re_Date[1] == 3)
        {
            ReturnReviseFlag = -1;
        }
        else
        {
            ReturnReviseFlag = 1;
        }
        ReturnedWheelData[MotorSpeed_Re_Date[1]].ReturnedWheelHallCnt += (ReturnedWheelData[MotorSpeed_Re_Date[1]].ReturnedWheelSpeedValue* ReturnReviseFlag / 2);
        MotorSpeed_Re_Flag = 0;
    }
}
